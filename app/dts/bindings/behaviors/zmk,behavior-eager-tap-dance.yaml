## app/dts/bindings/behaviors/zmk,behavior-eager-tap-dance.yaml
```yaml
# Copyright (c) 2022 The ZMK Contributors
# SPDX-License-Identifier: MIT

description: Eager Tap Dance Behavior

compatible: "zmk,behavior-eager-tap-dance"

include: zero_param.yaml

properties:
  bindings:
    type: phandle-array
    required: true
  tapping-term-ms:
    type: int
    default: 200
```
